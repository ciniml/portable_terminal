## c6_updater/sdkconfig.defaults
```kconfig
# Updater-specific defaults. Mirrors the SDIO + esp_hosted side of the
# main app so the link-layer reaches the factory V1.4.1 C6 slave.

CONFIG_IDF_TARGET="esp32p4"
CONFIG_ESPTOOLPY_FLASHSIZE_16MB=y
CONFIG_ESPTOOLPY_FLASHSIZE="16MB"

CONFIG_PARTITION_TABLE_CUSTOM=y
CONFIG_PARTITION_TABLE_CUSTOM_FILENAME="partitions.csv"

# PSRAM is required by the M5 BSP-aligned I2C init we lift later; keep it
# on but small footprint.
CONFIG_SPIRAM=y
CONFIG_SPIRAM_MODE_HEX=y

CONFIG_ESP_CONSOLE_USB_SERIAL_JTAG=y
CONFIG_LOG_DEFAULT_LEVEL_INFO=y

# Hosted SDIO transport — same pins as the main app
# (sdkconfig.defaults.esp32p4) so we exercise the identical bus the
# 2.x app would later use.
CONFIG_ESP_HOSTED_ENABLED=y
CONFIG_ESP_HOSTED_IDF_SLAVE_TARGET="esp32c6"
CONFIG_ESP_HOSTED_SDIO_HOST_INTERFACE=y
CONFIG_ESP_HOSTED_SDIO_4_BIT_BUS=y
CONFIG_ESP_HOSTED_SDIO_RESET_ACTIVE_LOW=y
CONFIG_ESP_HOSTED_SDIO_GPIO_RESET_SLAVE=15
# esp_hosted 1.4.x uses these flat symbol names (no SLOT_x split).
CONFIG_ESP_HOSTED_SDIO_PIN_CMD=13
CONFIG_ESP_HOSTED_SDIO_PIN_CLK=12
CONFIG_ESP_HOSTED_SDIO_PIN_D0=11
CONFIG_ESP_HOSTED_SDIO_PRIV_PIN_D1_4BIT_BUS=10
CONFIG_ESP_HOSTED_SDIO_PIN_D2=9
CONFIG_ESP_HOSTED_SDIO_PIN_D3=8
```

## components/ble_config_service/Kconfig.projbuild
```kconfig
menu "Tab5 BLE configuration service"

    config TAB5_BLE_CONFIG_ENABLED
        bool "Enable BLE provisioning service"
        default y
        select BT_ENABLED
        select BT_CONTROLLER_DISABLED
        select BT_NIMBLE_ENABLED
        select ESP_HOSTED_ENABLE_BT_NIMBLE
        select ESP_HOSTED_NIMBLE_HCI_VHCI
        help
            Starts a NimBLE GATT server on boot so Wi-Fi / SSH /
            Tailscale credentials can be set from a phone or laptop
            via Web Bluetooth (docs/settings.html on this project's
            GitHub Pages site).

            ESP32-P4 has no on-chip BT radio — the host runs NimBLE
            on top of a Hosted Virtual HCI transport, routing through
            the on-board ESP32-C6 over SDIO. This option therefore
            selects the BT_NIMBLE + esp_hosted VHCI Kconfig values.

            Requires a C6 slave firmware built with Bluetooth
            controller support. esp_hosted's slave example already
            ships BT_ENABLED=y + BT_CONTROLLER_ONLY=y for the c6
            target (managed_components/.../slave/sdkconfig.defaults.
            esp32c6), so a slave fw built via slave_c6_fw/build.sh
            will have BT controller available. Once that blob is
            installed (manually or via the boot-time auto-update —
            see docs/C6_FW_UPDATE.md), the BLE setup channel works
            out of the box.

    config TAB5_BLE_DEVICE_NAME
        string "BLE advertising name"
        depends on TAB5_BLE_CONFIG_ENABLED
        default "Tab5"

endmenu
```

## components/tailscale/Kconfig
```kconfig
menu "Tailscale"

    config TAILSCALE_ENABLE
        bool "Enable Tailscale client"
        default y
        select WIREGUARD_ENABLE
        help
            Enable the Tailscale client.  The device will join the Tailscale
            network after WiFi connects, using the WireGuard data plane.

            Empty auth key at boot simply skips registration so it's safe
            to leave on by default; provision the auth_key (NVS key
            "auth_key" in namespace "tailscale") later via BLE or by
            rebuilding with CONFIG_TAILSCALE_AUTH_KEY set.

    config TAILSCALE_AUTH_KEY
        string "Pre-auth key (tskey-auth-...)"
        depends on TAILSCALE_ENABLE
        default ""
        help
            Tailscale pre-authentication key used for device registration.
            Generate at https://login.tailscale.com/admin/settings/keys.
            Can be overridden at runtime via NVS key "auth_key" in
            namespace "tailscale".

    config TAILSCALE_HOSTNAME
        string "Hostname on Tailscale network"
        depends on TAILSCALE_ENABLE
        default "esp32-serial"
        help
            The device hostname as it will appear in the Tailscale admin console.
            Can be overridden at runtime via NVS key "hostname".

    config TAILSCALE_CONTROL_SERVER
        string "Control server hostname"
        depends on TAILSCALE_ENABLE
        default "login.tailscale.com"
        help
            Tailscale control server hostname.  Change only for self-hosted
            Headscale deployments.
            Can be overridden at runtime via NVS key "ctrl_server".

    config TAILSCALE_LISTEN_PORT
        int "WireGuard listen port (0 = ephemeral)"
        depends on TAILSCALE_ENABLE
        range 0 65535
        default 41641
        help
            UDP port for the WireGuard data plane.  Tailscale conventionally
            uses 41641.  Set to 0 to use an ephemeral port.

    config TAILSCALE_DERP_ONLY
        bool "DERP-only mode (disable DISCO direct paths)"
        depends on TAILSCALE_ENABLE
        default n
        help
            Force all peer traffic through DERP relay servers.
            Useful for debugging or in networks that block direct UDP.

    config TAILSCALE_MAX_PEERS
        int "Maximum number of Tailscale peers"
        depends on TAILSCALE_ENABLE
        range 1 16
        default 8
        help
            Maximum number of Tailscale peers.  Sets WIREGUARD_MAX_PEERS
            when Tailscale is enabled.  Each peer uses ~800 bytes of SRAM.

endmenu
```

## components/usb_host_ftdi_sio/Kconfig
```kconfig
menu "USB Host FTDI SIO Driver"

    config USB_HOST_ENABLE_FTDI_SIO_DRIVER
        bool "Enable FTDI USB Serial Converter Driver"
        default n
        help
            Enable FTDI SIO USB host driver component.

endmenu
```

## components/wireguard/Kconfig
```kconfig
menu "WireGuard VPN"

    config WIREGUARD_ENABLE
        bool "Enable WireGuard VPN"
        default y
        help
            Enable WireGuard VPN support. The device will bring up a
            WireGuard tunnel after WiFi connects.

    config WIREGUARD_LOCAL_IP
        string "Local WireGuard IP address"
        depends on WIREGUARD_ENABLE
        default "10.0.0.2"
        help
            IPv4 address assigned to the WireGuard interface (e.g. "10.0.0.2").
            Can be overridden at runtime via NVS key "local_ip" in namespace "wireguard".

    config WIREGUARD_LOCAL_NETMASK
        string "Local WireGuard netmask"
        depends on WIREGUARD_ENABLE
        default "255.255.255.0"
        help
            Netmask for the WireGuard interface.
            Can be overridden at runtime via NVS key "local_netmask".

    config WIREGUARD_PRIVATE_KEY
        string "Private key (base64)"
        depends on WIREGUARD_ENABLE
        default ""
        help
            Base64-encoded 32-byte WireGuard private key for this device.
            Generate with: wg genkey
            Can be overridden at runtime via NVS key "private_key".

    config WIREGUARD_PEER_PUBLIC_KEY
        string "Peer public key (base64)"
        depends on WIREGUARD_ENABLE
        default ""
        help
            Base64-encoded 32-byte public key of the WireGuard peer.
            Can be overridden at runtime via NVS key "peer_pub_key".

    config WIREGUARD_PEER_ENDPOINT
        string "Peer endpoint hostname or IP"
        depends on WIREGUARD_ENABLE
        default ""
        help
            Hostname or IP address of the WireGuard server/peer.
            Can be overridden at runtime via NVS key "peer_endpoint".

    config WIREGUARD_PEER_PORT
        int "Peer endpoint port"
        depends on WIREGUARD_ENABLE
        range 1 65535
        default 51820
        help
            UDP port of the WireGuard peer.
            Can be overridden at runtime via NVS key "peer_port" (u16).

    config WIREGUARD_LISTEN_PORT
        int "Local listen port"
        depends on WIREGUARD_ENABLE
        range 0 65535
        default 51820
        help
            Local UDP port WireGuard listens on. 0 = ephemeral.
            Can be overridden at runtime via NVS key "listen_port" (u16).

    config WIREGUARD_KEEPALIVE
        int "Persistent keepalive interval (seconds, 0=disabled)"
        depends on WIREGUARD_ENABLE
        range 0 65535
        default 25
        help
            Persistent keepalive interval in seconds. 0 = disabled.
            Can be overridden at runtime via NVS key "keepalive" (u16).

    config WIREGUARD_SET_AS_DEFAULT_ROUTE
        bool "Set WireGuard interface as default route"
        depends on WIREGUARD_ENABLE
        default n
        help
            If enabled, all unrouted traffic is sent through WireGuard (full tunnel).
            For this serial bridge use case, leave DISABLED so TCP server traffic
            (ports 8888, 8889, 2217) stays on the local WiFi interface and the device
            remains reachable on the LAN. Enable only for full-tunnel deployments.
            Can be overridden at runtime via NVS key "set_default" (u8, 0/1).

    config WIREGUARD_NTP_SERVER
        string "NTP server hostname"
        depends on WIREGUARD_ENABLE
        default "ntp1.mfeed.ad.jp"
        help
            NTP server used to synchronize the system clock before starting the
            WireGuard tunnel. Accurate time is required for WireGuard's TAI64N
            timestamp; without it the remote peer will reject handshakes after
            a device reset.
            mfeed (ntp1/ntp2/ntp3.mfeed.ad.jp) is the default public NTP service
            widely used in Japan.
            Can be overridden at runtime via NVS key "ntp_server" in namespace "wireguard".

    config WIREGUARD_NTP_TIMEOUT_MS
        int "NTP sync timeout (ms)"
        depends on WIREGUARD_ENABLE
        range 1000 60000
        default 10000
        help
            Maximum time to wait for NTP synchronization before starting WireGuard.
            If the timeout expires without sync, WireGuard starts anyway with the
            current (potentially incorrect) system time and logs a warning.

    config WIREGUARD_MAX_PEERS
        int "Maximum number of WireGuard peers"
        depends on WIREGUARD_ENABLE
        range 1 16
        default 1
        help
            Maximum number of WireGuard peers that can be active simultaneously.
            Each peer consumes approximately 800 bytes of SRAM.
            Set to 1 for normal single-peer WireGuard use.
            Increase (e.g. to 8) when using managed mode with Tailscale.

endmenu
```

## sdkconfig.defaults.esp32p4
```kconfig
# ESP32-P4 / M5Stack Tab5 specific defaults.

CONFIG_IDF_TARGET="esp32p4"
CONFIG_ESPTOOLPY_FLASHSIZE_16MB=y
CONFIG_ESPTOOLPY_FLASHSIZE="16MB"

CONFIG_ESP32P4_SELECTS_REV_LESS_V3=y
CONFIG_ESP32P4_REV_MIN_100=y
CONFIG_ESP32P4_REV_MIN_FULL=100
CONFIG_ESP_REV_MIN_FULL=100

# PSRAM: Tab5 has 32MB hex-mode PSRAM @ 200 MHz.
# 1280x720x2 framebuffer = ~1.76 MB, so PSRAM is required for the LCD.
CONFIG_SPIRAM=y
CONFIG_SPIRAM_MODE_HEX=y
CONFIG_SPIRAM_SPEED_200M=y
CONFIG_SPIRAM_USE_MALLOC=y
CONFIG_SPIRAM_MALLOC_ALWAYSINTERNAL=16384

# Default console on the on-board USB-Serial-JTAG.
CONFIG_ESP_CONSOLE_USB_SERIAL_JTAG=y

# FreeRTOS tick at 1 kHz for terminal-friendly latency.
CONFIG_FREERTOS_HZ=1000

# Wi-Fi via the on-board ESP32-C6 over SDIO (esp_hosted slave).
# Pin/reset assignments mirror M5Stack's M5Tab5-UserDemo defaults.
CONFIG_ESP_HOSTED_ENABLED=y
CONFIG_ESP_HOSTED_IDF_SLAVE_TARGET="esp32c6"
CONFIG_ESP_HOSTED_SDIO_HOST_INTERFACE=y
# CONFIG_ESP_HOSTED_SPI_HOST_INTERFACE is not set
CONFIG_ESP_HOSTED_SDIO_4_BIT_BUS=y
# CONFIG_ESP_HOSTED_SDIO_1_BIT_BUS is not set
# Polarity workaround for esp_hosted 2.x + Tab5: upstream's reset_slave
# sequence is X -> !X -> X, leaving the pin driven at the "ACTIVE" level
# on exit. Tab5's GPIO 15 is wired to the C6's CHIP_EN (HIGH = run, LOW =
# reset). To leave the C6 running after the pulse — which is what
# sdmmc_card_init's CMD5 needs to succeed — we tell esp_hosted that this
# is an "active high" reset so its `ACTIVE` level becomes HIGH. The pulse
# polarity is technically inverted from the conventional "active-low
# reset" naming, but the resulting waveform (HIGH → LOW → HIGH) is exactly
# what the C6 wants for a clean reset + release.
# CONFIG_ESP_HOSTED_SDIO_RESET_ACTIVE_LOW is not set
CONFIG_ESP_HOSTED_SDIO_RESET_ACTIVE_HIGH=y
CONFIG_ESP_HOSTED_SDIO_OPTIMIZATION_RX_STREAMING_MODE=y
CONFIG_ESP_HOSTED_SDIO_GPIO_RESET_SLAVE=15
# CONFIG_ESP_HOSTED_SDIO_PIN_* are computed Kconfig values; the actual
# user-visible knobs (slot 1, 4-bit bus) are the PRIV_ ones below.
CONFIG_ESP_HOSTED_PRIV_SDIO_PIN_CMD_SLOT_1=13
CONFIG_ESP_HOSTED_PRIV_SDIO_PIN_CLK_SLOT_1=12
CONFIG_ESP_HOSTED_PRIV_SDIO_PIN_D0_SLOT_1=11
CONFIG_ESP_HOSTED_PRIV_SDIO_PIN_D1_4BIT_BUS_SLOT_1=10
CONFIG_ESP_HOSTED_PRIV_SDIO_PIN_D2_4BIT_BUS_SLOT_1=9
CONFIG_ESP_HOSTED_PRIV_SDIO_PIN_D3_4BIT_BUS_SLOT_1=8

# Tab5 + IDF 6.0: drop the SDIO clock from the 40 MHz default to 20 MHz.
# At 40 MHz CMD5 (send_op_cond) times out repeatedly; the lower bus
# speed gives the bus margin for the slightly tighter IDF 6 timings.
# Bump back to 40000 once the link is verified stable at 20.
CONFIG_ESP_HOSTED_SDIO_CLOCK_FREQ_KHZ=20000

CONFIG_TAB5_WIFI_ENABLED=y
```
