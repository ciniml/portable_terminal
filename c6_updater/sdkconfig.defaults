## sdkconfig.defaults.local.example
```kconfig
# Copy to sdkconfig.defaults.local (gitignored) and put host-specific
# overrides here. The Makefile chains this file after
# sdkconfig.defaults and sdkconfig.defaults.<target>, so any values here
# take precedence over committed defaults but are never staged in git.
#
# Re-trigger a sdkconfig regeneration after editing:
#   rm sdkconfig && make build

# --- Wi-Fi ------------------------------------------------------------
# CONFIG_TAB5_WIFI_ENABLED=y
# CONFIG_TAB5_WIFI_SSID="my-home-ssid"
# CONFIG_TAB5_WIFI_PSK="my-home-passphrase"
# CONFIG_TAB5_WIFI_CONNECT_TIMEOUT_S=20

# --- UART input (if your Tab5 wiring uses different pins) -------------
# CONFIG_TAB5_UART_INPUT_TX_GPIO=54
# CONFIG_TAB5_UART_INPUT_RX_GPIO=53
# CONFIG_TAB5_UART_INPUT_BAUD=115200

# --- Remote connection (SSH preferred, Telnet fallback) ---------------
# When both are enabled, SSH is attempted first; Telnet is used only
# when SSH start fails (or is disabled). Both require Wi-Fi enabled.

# --- Telnet -----------------------------------------------------------
# CONFIG_TAB5_TELNET_ENABLED=y
# CONFIG_TAB5_TELNET_HOST="192.168.1.5"
# CONFIG_TAB5_TELNET_PORT=23
# CONFIG_TAB5_TELNET_RX_TASK_STACK=6144

# --- SSH client (requires Wi-Fi enabled) ------------------------------
# CONFIG_TAB5_SSH_ENABLED=y
# CONFIG_TAB5_SSH_HOST="192.168.1.10"
# CONFIG_TAB5_SSH_PORT=22
# CONFIG_TAB5_SSH_USER="me"
# CONFIG_TAB5_SSH_PASSWORD="hunter2"
# CONFIG_TAB5_SSH_RX_TASK_STACK=8192
# Public-key auth — place your private key at main/keys/id_rsa (PEM RSA).
# Falls back to TAB5_SSH_PASSWORD on auth failure.
#   ssh-keygen -m PEM -t rsa -b 2048 -f main/keys/id_rsa
#   ssh-copy-id -i main/keys/id_rsa.pub me@192.168.1.10
# CONFIG_TAB5_SSH_PUBKEY_AUTH=y
# CONFIG_TAB5_SSH_KEY_PASSPHRASE=""

# --- WireGuard VPN (opt-in) -------------------------------------------
# Bring up a WireGuard tunnel after Wi-Fi connects. The component's
# Kconfig values are the boot-time defaults; runtime overrides come
# from NVS namespace "wireguard" (set elsewhere — there's no on-device
# editor yet).
# CONFIG_WIREGUARD_ENABLE=y
# CONFIG_WIREGUARD_LOCAL_IP="10.0.0.2"
# CONFIG_WIREGUARD_LOCAL_NETMASK="255.255.255.0"
# CONFIG_WIREGUARD_PRIVATE_KEY="<base64 private key (wg genkey)>"
# CONFIG_WIREGUARD_PEER_PUBLIC_KEY="<base64 peer pubkey>"
# CONFIG_WIREGUARD_PEER_ENDPOINT="vpn.example.com"
# CONFIG_WIREGUARD_PEER_PORT=51820
# CONFIG_WIREGUARD_PERSISTENT_KEEPALIVE=25

# --- Tailscale (opt-in; auto-selects when both enabled) ----------------
# Tailscale uses the WireGuard data plane (auto-enabled) but talks to a
# control server for netmap / DERP / DISCO. Generate an auth key at
# https://login.tailscale.com/admin/settings/keys and paste below.
# CONFIG_TAILSCALE_ENABLE=y
# CONFIG_TAILSCALE_AUTH_KEY="tskey-auth-..."
# CONFIG_TAILSCALE_HOSTNAME="tab5"
# CONFIG_TAILSCALE_CONTROL_SERVER="login.tailscale.com"
# CONFIG_TAILSCALE_LISTEN_PORT=41641
```
